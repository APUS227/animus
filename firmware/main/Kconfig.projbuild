## firmware/main/Kconfig.projbuild
```kconfig
menu "Animus Configuration"

    config ANIMUS_WIFI_SSID
        string "WiFi SSID (developer fallback)"
        default ""
        help
            Leave EMPTY for normal use: the device will start its
            captive setup portal (WiFi "animus-setup") and let the
            user configure networking from a phone. Set a value only
            for development builds where reflashing often is easier
            than re-provisioning.

    config ANIMUS_WIFI_PASSWORD
        string "WiFi password (developer fallback)"
        default ""

    config ANIMUS_DEVICE_NAME
        string "Device name (reported over MCP)"
        default "animus-1"

    config ANIMUS_AUTH_TOKEN
        string "Bearer auth token (empty = auth disabled)"
        default ""
        help
            If set, every MCP request must carry the header
            "Authorization: Bearer <token>". Strongly recommended
            on any network you do not fully control.

endmenu
```

## firmware/sdkconfig.defaults
```kconfig
# Animus defaults
# Larger header buffer: MCP clients can send long Authorization / protocol headers
CONFIG_HTTPD_MAX_REQ_HDR_LEN=1024
CONFIG_ESP_MAIN_TASK_STACK_SIZE=6144
```
